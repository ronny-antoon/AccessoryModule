## components/AccessoryModule/Kconfig.projbuild
```kconfig
menu "Accessory Module"
    menu "Blind Accessory"
        config A_M_BLIND_ACCESSORY_MOVING_STACK_SIZE
            int "Blind Accessory Moving Task Stack Size"
            default 4096
            range 1024 16384

        config A_M_BLIND_ACCESSORY_MOVING_PRIORITY
            int "Blind Accessory Moving Task Priority"
            default 1
            range 1 31

        config A_M_BLIND_ACCESSORY_IDENTIFY_STACK_SIZE
            int "Blind Accessory Identify Task Stack Size"
            default 4096
            range 1024 16384
        
        config A_M_BLIND_ACCESSORY_IDENTIFY_PRIORITY
            int "Blind Accessory Identify Task Priority"
            default 5
            range 1 31
    endmenu

    menu "Door Accessory"
      config A_M_DOOR_ACCESSORY_OPENING_STACK_SIZE
          int "Door Accessory Opening Task Stack Size"
          default 4096
          range 1024 16384

      config A_M_DOOR_ACCESSORY_OPENING_PRIORITY
          int "Door Accessory Opening Task Priority"
          default 1
          range 1 31

      config A_M_DOOR_ACCESSORY_IDENTIFY_STACK_SIZE
          int "Door Accessory Identify Task Stack Size"
          default 4096
          range 1024 16384
      
      config A_M_DOOR_ACCESSORY_IDENTIFY_PRIORITY
          int "Door Accessory Identify Task Priority"
          default 5
          range 1 31
    endmenu

    menu "Fan Accessory"
      config A_M_FAN_ACCESSORY_IDENTIFY_STACK_SIZE
        int "Fan Accessory Identify Task Stack Size"
        default 4096
        range 1024 16384
    
      config A_M_FAN_ACCESSORY_IDENTIFY_PRIORITY
        int "Fan Accessory Identify Task Priority"
        default 5
        range 1 31
    endmenu

    menu "Light Accessory"
      config A_M_LIGHT_ACCESSORY_IDENTIFY_STACK_SIZE
        int "Light Accessory Identify Task Stack Size"
        default 4096
        range 1024 16384
    
      config A_M_LIGHT_ACCESSORY_IDENTIFY_PRIORITY
        int "Light Accessory Identify Task Priority"
        default 5
        range 1 31
    endmenu

    menu "Plugin Accessory"
      config A_M_PLUGIN_ACCESSORY_IDENTIFY_STACK_SIZE
        int "Plugin Accessory Identify Task Stack Size"
        default 4096
        range 1024 16384
    
      config A_M_PLUGIN_ACCESSORY_IDENTIFY_PRIORITY
        int "Plugin Accessory Identify Task Priority"
        default 5
        range 1 31
    endmenu

    menu "Switch Accessory"
      config A_M_SWITCH_ACCESSORY_IDENTIFY_STACK_SIZE
        int "Switch Accessory Identify Task Stack Size"
        default 4096
        range 1024 16384
    
      config A_M_SWITCH_ACCESSORY_IDENTIFY_PRIORITY
        int "Switch Accessory Identify Task Priority"
        default 5
        range 1 31
    endmenu
endmenu
```

## sdkconfig.defaults
```kconfig
CONFIG_UNITY_ENABLE_FIXTURE=y

CONFIG_HEAP_TRACING_STANDALONE=y
CONFIG_HEAP_TRACING_DEST=y
```
